## arch/arm64/hotplug/Kconfig
```kconfig
config HIMA_HOTPLUG
        bool "Enable hima-hotplug cpu hotplug driver"
	depends on STATE_NOTIFIER
        default y
        help
          Generic cpu hotplugging driver for ARM SOCs
```
